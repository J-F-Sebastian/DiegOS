## Kconfig
```kconfig
#
# For a description of the syntax of this configuration file,
# see Documentation/kbuild/kconfig-language.txt.
#
mainmenu "DiegOS Configuration"

source "Kconfig.parameters"
source "Kconfig.processor"
source "Kconfig.platform"
```

## Kconfig.parameters
```kconfig
config  MAX_THREADS
	int
	default 16
	range 1 240
	prompt "Maximum number of threads"
	help
		The maximum number of user threads.
		The OS is not allowed to spawn more than
		this amount of threads.

config	CLOCK_RES
	int
	default 100
	range 10 1000
	prompt "Clock resolution (Hz)"
	help
		The system clock resolution in Hz,
		system ticks will increase at this rate.

config BANNER
	string
	default "Welcome to DiegOS"
	prompt "Login banner"
	help
		The login banner
```

## Kconfig.platform
```kconfig
choice  Platform
	prompt "Target Platform"
	default	PC
	help
		Select the target platform (Board)

config	PC
	bool
	prompt "Intel PC architecture"
	help
		Select this option if your target
		board is an intel PC

endchoice

if PC
source "./platforms/configs/Kconfig.pc"
endif
```

## Kconfig.processor
```kconfig
choice Processor
	prompt "Target processor"
	default	IA32
	help
		Select the target processor

config	IA32
	bool
	prompt "Intel 32-bit architecture"
	help
		Select this option if your target
		processor is an Intel 32-bit architecture

config	ARMv4
	bool
	prompt "ARM 32-bit architecture"
	help
		Select this option if your target
		processor is an ARMv4 32-bit architecture

config	ARMv5e
	bool
	prompt "ARM 32-bit architecture + DSP"
	help
		Select this option if your target
		processor is an ARMv5 32-bit architecture
		with additional DSP instructions

config  MIPS
	bool
	prompt "MIPS 32-bit architecture"
	help
		Select this option if your target
		processor is a MIPS 32-bit architecture

endchoice

if IA32
source "./platforms/configs/Kconfig.ia32"
endif

if ARMv4
source "./platforms/configs/Kconfig.armv4"
endif

if ARMv5e
source "./platforms/configs/Kconfig.armv5e"
endif

if MIPS
source "./platforms/configs/Kconfig.mips"
endif
```
